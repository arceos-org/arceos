## tools/bsta1000b/bsta1000b-fada-arceos.its
```
/*
 * U-Boot uImage source file with multiple kernels, ramdisks and FDT blobs
 */

/dts-v1/;

/ {
	description = "Various kernels, ramdisks and FDT blobs";
	#address-cells = <1>;

	images {
		kernel {
			description = "ArceOS for BST A1000B";
			data = /incbin/("../../arceos-fada.bin.gz");
			type = "kernel";
			arch = "arm64";
			os = "linux";
			compression = "gzip";
			load = <0x81000000>;
			entry = <0x81000000>;
			hash-1 {
				algo = "md5";
			};
			hash-2 {
				algo = "sha1";
			};
		};

		fdt-fada {
			description = "bsta1000b-fada fdt";
			data = /incbin/("./bsta1000b-fada.dtb");
			type = "flat_dt";
			arch = "arm64";
			compression = "none";
			hash-1 {
				algo = "crc32";
			};
		};
	};

	configurations {
		default = "config-fada";

		config-fada {
			description = "bsta1000b fada configuration";
			kernel = "kernel";
			fdt = "fdt-fada";
		};
	};
};
```

## tools/fu740/fu740_uboot_fit.its
```
/*
 * Simple U-Boot uImage source file containing a single kernel and FDT blob
 */

/dts-v1/;

/ {
	description = "Simple image with single ArceOS kernel and FDT blob for fu740";
	#address-cells = <1>;

	images {
		kernel {
			description = "ArceOS kernel for fu740";
			data = /incbin/("../../arceos-fu740.bin.gz");
			type = "kernel";
			arch = "riscv";
			os = "linux";
			compression = "gzip";
			load = <0x80200000>;
			entry = <0x80200000>;
		};
		fdt-1 {
			description = "Flattened Device Tree blob";
			data = /incbin/("./hifive-unmatched-a00.dtb");
			type = "flat_dt";
			arch = "riscv";
			compression = "none";
		};
	};

	configurations {
		default = "ArceOS-for-fu740";
		ArceOS-for-fu740 {
			description = "Boot ArceOS kernel with FDT blob for fu740";
			kernel = "kernel";
			fdt = "fdt-1";
		};
	};
};
```

## tools/rk3588/boot.its
```
/*
 * Copyright (C) 2021 Rockchip Electronics Co., Ltd
 *
 * SPDX-License-Identifier: GPL-2.0
 */

/dts-v1/;
/ {
    description = "U-Boot FIT source file for arm";

    images {
        fdt {
            data = /incbin/("kernel/arch/arm64/boot/dts/rockchip/rk3588-evb1-lp4-v10-linux.dtb");
            type = "flat_dt";
            arch = "arm64";
            compression = "none";
            load = <0xffffff00>;

            hash {
                algo = "sha256";
            };
        };

        kernel {
            data = /incbin/("kernel/arch/arm64/boot/Image");
            type = "kernel";
            arch = "arm64";
            os = "linux";
            compression = "none";
            entry = <0xffffff01>;
            load = <0xffffff01>;

            hash {
                algo = "sha256";
            };
        };

		ramdisk {
			data = /incbin/("kernel/ramdisk.img");
			type = "ramdisk";
			arch = "arm64";
			os = "linux";
			compression = "none";
			load = <0xffffff02>;

			hash {
				algo = "sha256";
			};
		};

        resource {
            data = /incbin/("kernel/resource.img");
            type = "multi";
            arch = "arm64";
            compression = "none";

            hash {
                algo = "sha256";
            };
        };
    };

    configurations {
        default = "conf";

        conf {
            rollback-index = <0x00>;
            fdt = "fdt";
            kernel = "kernel";
            ramdisk = "ramdisk";
            multi = "resource";

            signature {
                algo = "sha256,rsa2048";
                padding = "pss";
                key-name-hint = "dev";
                sign-images = "fdt", "kernel", "ramdisk", "multi";
            };
        };
    };
};
```
